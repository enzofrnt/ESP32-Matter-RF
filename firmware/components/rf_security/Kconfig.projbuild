## firmware/components/rf_security/Kconfig.projbuild
```kconfig
menu "RF Security Configuration"

    config RF_AES_KEY
        string "Clé AES-128 (32 caractères hexadécimaux = 16 bytes)"
        default "00112233445566778899AABBCCDDEEFF"
        help
            Clé AES-128 en hexadécimal (exactement 32 caractères).
            Exemple: 00112233445566778899AABBCCDDEEFF
            DOIT être identique sur bridge et relais pour que la communication fonctionne.
            Changez cette valeur pour chaque installation pour éviter les interférences.

endmenu
```

## firmware/matter-bridge/Kconfig.projbuild
```kconfig
menu "Matter Bridge Configuration"

    config SYNC_STATUS_INTERVAL_SEC
        int "Intervalle de synchronisation du statut (secondes)"
        range 5 300
        default 30
        help
            Intervalle en secondes entre chaque demande de statut aux relais.
            Permet de maintenir la synchronisation entre le bridge Matter et les relais.

endmenu
```
